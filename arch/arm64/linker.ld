/* arch/arm64/linker.ld — размещение ядра на AArch64.
 *
 * Отличие от x86-шного linker.ld: там адрес 1 MiB — конвенция Multiboot.
 * Здесь 0x40080000 — это база ОЗУ QEMU virt (0x40000000) плюс text_offset
 * из заголовка Image (0x80000). Ровно туда же кладут образ LK/ABL на
 * реальных Qualcomm-устройствах (там база другая, но и она берётся из
 * заголовка Android boot.img — --base, см. Makefile цель bootimg).
 *
 * Секция .text.boot вынесена вперёд принудительно: заголовок ARM64 Image
 * обязан лежать в первых 64 байтах образа, иначе загрузчик его не найдёт.
 */
ENTRY(_start)

/* База ОЗУ, на которую слинкован образ. Переопределяется извне
 * (--defsym RAM_BASE_OVERRIDE=...) — это нужно, чтобы ПРОВЕРИТЬ механизм
 * перемещения: слинковав образ на заведомо неверный адрес и запустив его в
 * эмуляторе, мы убеждаемся, что перемещение действительно работает, а не
 * что нам просто повезло с совпадением адресов. */
RAM_BASE    = DEFINED(RAM_BASE_OVERRIDE) ? RAM_BASE_OVERRIDE : 0x40000000;
TEXT_OFFSET = 0x00080000;
STACK_SIZE  = 0x00010000;   /* 64 KiB — против 16 KiB на x86: тут глубже
                                стек у отрисовки GUI и парсера fw_cfg */

SECTIONS
{
    . = RAM_BASE + TEXT_OFFSET;
    __image_start = .;

    .text : ALIGN(4K) {
        KEEP(*(.text.boot))     /* заголовок Image + точка входа — строго первыми */
        *(.text*)
    }

    .rodata : ALIGN(4K) {
        *(.rodata*)
    }

    /* Таблица релокаций. Образ собирается позиционно-независимым, и здесь
     * лежит список мест, которые надо поправить, если загрузчик положил нас
     * не по тому адресу, на который мы слинкованы. Обрабатывает её boot.S
     * до вызова любого C-кода. KEEP обязателен: без него ld выбросит
     * секцию как неиспользуемую, и образ молча перестанет relocate-иться. */
    . = ALIGN(8);
    __rela_start = .;
    .rela.dyn : { *(.rela .rela*) }
    __rela_end = .;

    .data : ALIGN(4K) {
        *(.data*)
    }

    /* Границы .bss выровнены на 8: boot.S обнуляет её инструкцией
       "str xzr, [x1], #8" — по 8 байт за раз. */
    . = ALIGN(8);
    __bss_start = .;
    .bss : {
        *(COMMON)
        *(.bss*)
    }
    . = ALIGN(8);
    __bss_end = .;

    /* Стек ядра. Лежит за .bss и НЕ обнуляется (незачем) — но обязан
       попасть в __image_size, иначе загрузчик посчитает эту память
       свободной и может положить туда ramdisk/DTB прямо нам под ноги. */
    . = ALIGN(16);
    . = . + STACK_SIZE;
    __stack_top = .;

    /* ОБЛАСТЬ ДЛЯ ОБМЕНА С УСТРОЙСТВАМИ, КОТОРЫЕ ХОДЯТ В ПАМЯТЬ САМИ.
     *
     * Контроллер USB читает очередь событий и описатели передач своими
     * силами, не спрашивая процессор. Кэш он при этом не видит: то, что мы
     * записали, для него может ещё лежать в кэше, а то, что записал он, у
     * нас может оказаться перекрыто устаревшей строкой кэша.
     *
     * Поэтому область вынесена отдельно и отображается некэшируемой (см.
     * mmu.c). Выравнивание на 2 МиБ — не прихоть: атрибуты памяти
     * задаются блоками такого размера, и меньший кусок пришлось бы
     * описывать отдельной таблицей третьего уровня.
     *
     * Места в образе она не занимает: здесь только двигается счётчик
     * адреса, ни одного байта не выкладывается. Зато она попадает в
     * __image_size, и загрузчик не положит туда ramdisk. */
    . = ALIGN(0x200000);
    __dma_start = .;
    . = . + 0x200000;
    __dma_end = .;

    __image_end = .;
    __image_size = __image_end - __image_start;

    /DISCARD/ : {
        *(.comment)
        *(.note*)
        *(.eh_frame*)
    }
}
